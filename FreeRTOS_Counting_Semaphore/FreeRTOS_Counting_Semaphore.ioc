# file: FreeRTOS_Counting_Semaphore.ioc
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FREERTOS.CountingSemaphores01=myCountingSem01,3,Dynamic,NULL
FREERTOS.Tasks01=Task_one,8,128,TaskOne,Default,NULL,Dynamic,NULL,NULL;Task_two,8,128,Tasktwo,Default,NULL,Dynamic,NULL,NULL;Task_three,8,128,TaskThree,Default,NULL,Dynamic,NULL,NULL;Task_Four,8,128,TaskFour,Default,NULL,Dynamic,NULL,NULL
Mcu.Family=STM32F4
Mcu.Name=STM32F401R(B-C)Tx
Mcu.Package=LQFP64
NVIC.EXTI15_10_IRQn=true\:5\:0\:false\:false\:true\:true\:true\:true
NVIC.PriorityGroup=NVIC_PRIORITYGROUP_4
NVIC.TIM4_IRQn=true\:15\:0\:false\:false\:true\:false\:false\:true
NVIC.TimeBase=TIM4_IRQn
NVIC.TimeBaseIP=TIM4
PB10.Signal=GPXTI10
PH0\ -\ OSC_IN.Mode=HSE-External-Clock-Source
PH0\ -\ OSC_IN.Signal=RCC_OSC_IN
PH1\ -\ OSC_OUT.Mode=HSE-External-Clock-Source
PH1\ -\ OSC_OUT.Signal=RCC_OSC_OUT
ProjectManager.HeapSize=0x200
ProjectManager.StackSize=0x400
ProjectManager.TargetToolchain=STM32CubeIDE
RCC.AHBFreq_Value=16000000
RCC.APB1Freq_Value=16000000
RCC.APB2Freq_Value=16000000
RCC.CortexFreq_Value=16000000
RCC.HSE_VALUE=25000000
RCC.HSI_VALUE=16000000
RCC.LSE_VALUE=32768
RCC.SYSCLKFreq_VALUE=16000000
RCC.VCOOutputFreq_Value=192000000
VP_FREERTOS_VS_CMSIS_V2.Mode=CMSIS_V2
VP_SYS_VS_tim4.Mode=TIM4
board=custom

// file: Core/Src/main.c
/* USER CODE BEGIN Header */
/**
  ******************************************************************************
  * @file           : main.c
  * @brief          : Main program body
  ******************************************************************************
  * @attention
  *
  * <h2><center>&copy; Copyright (c) 2024 STMicroelectronics.
  * All rights reserved.</center></h2>
  *
  * This software component is licensed by ST under Ultimate Liberty license
  * SLA0044, the "License"; You may not use this file except in compliance with
  * the License. You may obtain a copy of the License at:
  *                             www.st.com/SLA0044
  *
  ******************************************************************************
  */
/* USER CODE END Header */
#include "main.h"
#include "cmsis_os.h"
#include "gpio.h"

/* USER CODE BEGIN Includes */
#include <stdio.h>
/* USER CODE END Includes */

/* USER CODE BEGIN PTD */
extern osSemaphoreId_t myCountingSem01Handle;
/* USER CODE END PTD */

void SystemClock_Config(void);
void MX_FREERTOS_Init(void);

/* USER CODE BEGIN 0 */
void HAL_GPIO_EXTI_Callback(uint16_t GPIO_Pin)
{
  /* Prevent unused argument(s) compilation warning */
  UNUSED(GPIO_Pin);
  /* NOTE: This function Should not be modified, when the callback is needed,
           the HAL_GPIO_EXTI_Callback could be implemented in the user file */
  /* release counting semaphore */
  osSemaphoreRelease(myCountingSem01Handle);
  printf("HAL_GPIO_EXTI_Callback is running \n");

}
/* USER CODE END 0 */

int main(void)
{

  /* MCU Configuration--------------------------------------------------------*/

  /* Reset of all peripherals, Initializes the Flash interface and the Systick. */
  HAL_Init();

  /* Configure the system clock */
  SystemClock_Config();

  /* Initialize all configured peripherals */
  MX_GPIO_Init();

  /* Init scheduler */
  osKernelInitialize();  /* Call init function for freertos objects (in freertos.c) */
  MX_FREERTOS_Init();
  /* Start scheduler */
  osKernelStart();

  /* We should never get here as control is now taken by the scheduler */
  /* Infinite loop */
  while (1)
  {

  }
}

void SystemClock_Config(void)
{
  RCC_OscInitTypeDef RCC_OscInitStruct = {0};
  RCC_ClkInitTypeDef RCC_ClkInitStruct = {0};

  /** Configure the main internal regulator output voltage
  */
  __HAL_RCC_PWR_CLK_ENABLE();
  __HAL_PWR_VOLTAGESCALING_CONFIG(PWR_REGULATOR_VOLTAGE_SCALE2);
  /** Initializes the RCC Oscillators according to the specified parameters
  * in the RCC_OscInitTypeDef structure.
  */
  RCC_OscInitStruct.OscillatorType = RCC_OSCILLATORTYPE_HSI;
  RCC_OscInitStruct.HSIState = RCC_HSI_ON;
  RCC_OscInitStruct.HSICalibrationValue = RCC_HSICALIBRATION_DEFAULT;
  RCC_OscInitStruct.PLL.PLLState = RCC_PLL_NONE;
  if (HAL_RCC_OscConfig(&RCC_OscInitStruct) != HAL_OK)
  {
    Error_Handler();
  }
  /** Initializes the CPU, AHB and APB buses clocks
  */
  RCC_ClkInitStruct.ClockType = RCC_CLOCKTYPE_HCLK|RCC_CLOCKTYPE_SYSCLK
                              |RCC_CLOCKTYPE_PCLK1|RCC_CLOCKTYPE_PCLK2;
  RCC_ClkInitStruct.SYSCLKSource = RCC_SYSCLKSOURCE_HSI;
  RCC_ClkInitStruct.AHBCLKDivider = RCC_SYSCLK_DIV1;
  RCC_ClkInitStruct.APB1CLKDivider = RCC_HCLK_DIV1;
  RCC_ClkInitStruct.APB2CLKDivider = RCC_HCLK_DIV1;

  if (HAL_RCC_ClockConfig(&RCC_ClkInitStruct, FLASH_LATENCY_0) != HAL_OK)
  {
    Error_Handler();
  }
}

void HAL_TIM_PeriodElapsedCallback(TIM_HandleTypeDef *htim)
{
  if (htim->Instance == TIM4) {
    HAL_IncTick();
  }
}

void Error_Handler(void)
{
  __disable_irq();
  while (1)
  {
  }
}

/************************ (C) COPYRIGHT STMicroelectronics *****END OF FILE****/

// file: Core/Src/freertos.c
/* USER CODE BEGIN Header */
/**
  ******************************************************************************
  * File Name          : freertos.c
  * Description        : Code for freertos applications
  ******************************************************************************
  * @attention
  *
  * <h2><center>&copy; Copyright (c) 2024 STMicroelectronics.
  * All rights reserved.</center></h2>
  *
  * This software component is licensed by ST under Ultimate Liberty license
  * SLA0044, the "License"; You may not use this file except in compliance with
  * the License. You may obtain a copy of the License at:
  *                             www.st.com/SLA0044
  *
  ******************************************************************************
  */
/* USER CODE END Header */

#include "FreeRTOS.h"
#include "task.h"
#include "main.h"
#include "cmsis_os.h"

/* USER CODE BEGIN Includes */
#include <stdio.h>
/* USER CODE END Includes */

/* Definitions for Task_one */
osThreadId_t Task_oneHandle;
const osThreadAttr_t Task_one_attributes = {
  .name = "Task_one",
  .stack_size = 128 * 4,
  .priority = (osPriority_t) osPriorityLow,
};
/* Definitions for Task_two */
osThreadId_t Task_twoHandle;
const osThreadAttr_t Task_two_attributes = {
  .name = "Task_two",
  .stack_size = 128 * 4,
  .priority = (osPriority_t) osPriorityLow,
};
/* Definitions for Task_three */
osThreadId_t Task_threeHandle;
const osThreadAttr_t Task_three_attributes = {
  .name = "Task_three",
  .stack_size = 128 * 4,
  .priority = (osPriority_t) osPriorityLow,
};
/* Definitions for Task_Four */
osThreadId_t Task_FourHandle;
const osThreadAttr_t Task_Four_attributes = {
  .name = "Task_Four",
  .stack_size = 128 * 4,
  .priority = (osPriority_t) osPriorityLow,
};
/* Definitions for myCountingSem01 */
osSemaphoreId_t myCountingSem01Handle;
const osSemaphoreAttr_t myCountingSem01_attributes = {
  .name = "myCountingSem01"
};

void TaskOne(void *argument);
void Tasktwo(void *argument);
void TaskThree(void *argument);
void TaskFour(void *argument);

void MX_FREERTOS_Init(void); /* (MISRA C 2004 rule 8.1) */

void MX_FREERTOS_Init(void) {

  /* Create the semaphores(s) */
  /* creation of myCountingSem01 */
  myCountingSem01Handle = osSemaphoreNew(3, 0, &myCountingSem01_attributes);

  /* Create the thread(s) */
  /* creation of Task_one */
  Task_oneHandle = osThreadNew(TaskOne, NULL, &Task_one_attributes);

  /* creation of Task_two */
  Task_twoHandle = osThreadNew(Tasktwo, NULL, &Task_two_attributes);

  /* creation of Task_three */
  Task_threeHandle = osThreadNew(TaskThree, NULL, &Task_three_attributes);

  /* creation of Task_Four */
  Task_FourHandle = osThreadNew(TaskFour, NULL, &Task_Four_attributes);

}

void TaskOne(void *argument)
{
  /* USER CODE BEGIN TaskOne */
	uint32_t Task_Counter = 0;
  /* Infinite loop */
  for(;;)
  {
     osSemaphoreRelease(myCountingSem01Handle);
     Task_Counter++;
     printf("TaskOne is running : %i",(signed int)Task_Counter);
     osDelay(500);
  }
  /* USER CODE END TaskOne */
}

void Tasktwo(void *argument)
{
	/* USER CODE BEGIN TaskOne */
		uint32_t Task_Counter = 0;
	  /* Infinite loop */
	  for(;;)
	  {
	     osSemaphoreRelease(myCountingSem01Handle);
	     Task_Counter++;
	     printf("Tasktwo is running : %i",(signed int)Task_Counter);
	     osDelay(1500);
	  }
	  /* USER CODE END TaskOne */
}

void TaskThree(void *argument)
{
	/* USER CODE BEGIN TaskOne */
		uint32_t Task_Counter = 0;
	  /* Infinite loop */
	  for(;;)
	  {
	     osSemaphoreRelease(myCountingSem01Handle);
	     Task_Counter++;
	     printf("TaskThree is running : %i",(signed int)Task_Counter);
	     osDelay(1500);
	  }
	  /* USER CODE END TaskOne */
}

void TaskFour(void *argument)
{
	/* USER CODE BEGIN TaskOne */
		uint32_t Task_Counter = 0;
	  /* Infinite loop */
	  for(;;)
	  {
	     osSemaphoreAcquire(myCountingSem01Handle,5000);
	     osSemaphoreAcquire(myCountingSem01Handle,5000);
	     osSemaphoreAcquire(myCountingSem01Handle,5000);
	     Task_Counter++;
	     printf("TaskOne is running : %i",(signed int)Task_Counter);
	  }
	  /* USER CODE END TaskOne */
}

/************************ (C) COPYRIGHT STMicroelectronics *****END OF FILE****/
